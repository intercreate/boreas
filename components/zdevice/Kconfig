## components/zdevice/Kconfig
```kconfig
menu "Boreas Device Model (zdevice)"

    config DEVICE_REGISTRY_MAX
        int "Maximum number of registered devices"
        default 32
        help
            Maximum number of devices that can be registered via DEVICE_DEFINE.
            Each device uses one pointer slot in the global registry.

    config DEVICE_MODEL_I2C
        bool "Enable I2C bus driver"
        default n
        help
            Enable the I2C bus device implementation.
            Wraps ESP-IDF i2c_master with Zephyr-style i2c_dt_spec.

    config DEVICE_MODEL_SPI
        bool "Enable SPI bus driver"
        default n
        help
            Enable the SPI bus device implementation.
            Wraps ESP-IDF spi_master with Zephyr-style spi_dt_spec.

    config DEVICE_MODEL_GPIO
        bool "Enable GPIO controller driver"
        default n
        help
            Enable the GPIO controller device implementation.
            Wraps ESP-IDF GPIO with Zephyr-style gpio_dt_spec and gpio_api vtable.

    config DEVICE_MODEL_UART
        bool "Enable UART controller driver"
        default n
        help
            Enable the UART controller device implementation.
            Wraps ESP-IDF driver/uart with Zephyr-style uart_api vtable.
            Supports polling, interrupt-driven, and async modes; RS-485
            half-duplex as a flow_ctrl option. See boreas/uart_dt.h.

    if DEVICE_MODEL_UART

        config UART_INTERRUPT_DRIVEN
            bool "Enable interrupt-driven UART API"
            default y
            help
                Compile in uart_irq_* and uart_fifo_* helpers. Backed by
                the ESP-IDF UART event queue; a per-instance event task
                dispatches IDF events into the registered IRQ callback.

        config UART_ASYNC_API
            bool "Enable async UART API (uart_tx / uart_rx_enable)"
            default n
            help
                Compile in uart_tx and uart_rx_enable style async helpers
                that deliver events (UART_TX_DONE, UART_RX_RDY, etc.) via
                a uart_callback_t. Adds RX buffer management state.

        config UART_RS485
            bool "Enable RS-485 half-duplex flow control"
            default n
            select DEVICE_MODEL_GPIO
            help
                Allow uart_config.flow_ctrl = UART_CFG_FLOW_CTRL_RS485.
                Supports both software DE/RE toggle around TX and ESP32's
                built-in UART_MODE_RS485_HALF_DUPLEX auto-DE.

        config UART_EVENT_TASK_STACK
            int "Per-instance UART event task stack bytes"
            default 2048
            depends on UART_INTERRUPT_DRIVEN || UART_ASYNC_API
            help
                Stack size in bytes. Passed directly to xTaskCreate(),
                which on ESP-IDF FreeRTOS takes bytes (not words, unlike
                vanilla FreeRTOS -- see task.h usStackDepth docs).

        config UART_EVENT_TASK_PRIO
            int "Per-instance UART event task priority"
            default 10
            depends on UART_INTERRUPT_DRIVEN || UART_ASYNC_API

    endif

endmenu
```

## components/zkernel/Kconfig
```kconfig
menu "Boreas Kernel (zkernel)"

    config ZKERNEL_MUTEX_DEBUG
        bool "Enable mutex lock-ordering assertions"
        default n
        help
            When enabled, each mutex is assigned a numeric lock order.
            Acquiring mutexes out of order triggers an assertion failure.
            Adds ~4 bytes per mutex and a small runtime check on lock.

    config ZKERNEL_MUTEX_HOLD_WARNING_MS
        int "Mutex hold-time warning threshold (ms)"
        default 0
        depends on ZKERNEL_MUTEX_DEBUG
        help
            Log a warning if a mutex is held longer than this many
            milliseconds. Set to 0 to disable hold-time warnings.

    config ZKERNEL_THREAD_ANALYZER
        bool "Enable thread analyzer"
        default n
        help
            Enables runtime thread stack and CPU usage analysis.
            Adds a CLI command and periodic reporting capability.

    config ZKERNEL_SYS_INIT
        bool "Enable SYS_INIT ordered initialization framework"
        default y
        help
            Enables the SYS_INIT macro for declarative, priority-ordered
            component initialization and shutdown.

    config ZKERNEL_SYS_INIT_MAX_ENTRIES
        int "Maximum number of SYS_INIT entries"
        default 32
        depends on ZKERNEL_SYS_INIT
        help
            Maximum number of components that can register via SYS_INIT.

    config SYSTEM_WORKQUEUE_PRIORITY
        int "System workqueue thread priority"
        default 5
        help
            FreeRTOS task priority for the auto-initialized system
            workqueue (k_sys_work_q). Higher number = higher priority.
            Mirrors upstream Zephyr's CONFIG_SYSTEM_WORKQUEUE_PRIORITY.

    config SYSTEM_WORKQUEUE_STACK_SIZE
        int "System workqueue thread stack size (bytes)"
        default 4096
        help
            Stack size for the auto-initialized system workqueue
            (k_sys_work_q) worker thread. Mirrors upstream Zephyr's
            CONFIG_SYSTEM_WORKQUEUE_STACK_SIZE.

    config SYSTEM_WORKQUEUE_NO_YIELD
        bool "System workqueue: do not yield between work items"
        default n
        help
            When enabled, the system workqueue worker does not yield
            between handler invocations. Lets a high-priority worker
            drain its queue without preemption, at the cost of
            responsiveness for equal-or-lower-priority work. Mirrors
            upstream Zephyr's CONFIG_SYSTEM_WORKQUEUE_NO_YIELD.

    config K_TIMER_DISPATCH_ISR
        bool "Dispatch k_timer callbacks in ISR context"
        depends on !IDF_TARGET_LINUX
        default y
        select ESP_TIMER_SUPPORTS_ISR_DISPATCH_METHOD
        help
            When enabled, k_timer expiry callbacks run in true ISR context
            (ESP_TIMER_ISR dispatch), matching upstream Zephyr's contract.
            Callbacks must be IRAM_ATTR and must not call blocking APIs.

            When disabled, callbacks run on the ESP_TIMER_TASK (a normal
            FreeRTOS task). Blocking calls are permitted but the behavior
            diverges from upstream Zephyr.

            Unavailable on the linux target: esp_timer is headers-only
            there, and the k_timer linux backend dispatches from a
            dedicated FreeRTOS task (task-context semantics).

    config K_TIMER_LINUX_DISPATCHER_PRIORITY
        int "k_timer linux dispatcher task priority"
        depends on IDF_TARGET_LINUX
        default 20
        help
            FreeRTOS task priority for the k_timer expiry dispatcher on
            the linux target. Should be higher than any task that relies
            on timely k_timer / k_work_delayable expiry, mirroring the
            high-priority esp_timer task on hardware.

    config K_TIMER_LINUX_DISPATCHER_STACK_SIZE
        int "k_timer linux dispatcher task stack size (bytes)"
        depends on IDF_TARGET_LINUX
        default 8192
        help
            Stack size for the k_timer expiry dispatcher task on the
            linux target. Expiry callbacks run on this stack. Mirrors
            the SYSTEM_WORKQUEUE_STACK_SIZE pattern.

    config ZKERNEL_FATAL_CAPTURE
        bool "Capture fatal error context to NVS"
        default n
        help
            On fatal error or assertion failure, save task name, backtrace,
            and heap state to NVS. Printed on next boot.

endmenu
```

## examples/blink_device_model/sdkconfig.defaults
```kconfig
CONFIG_FREERTOS_HZ=1000
CONFIG_ESP_MAIN_TASK_STACK_SIZE=4096
CONFIG_DEVICE_MODEL_GPIO=y
CONFIG_ZSYS_LOG_MODULE=y

# zkernel k_sem reserves task-notification index 1
CONFIG_FREERTOS_TASK_NOTIFICATION_ARRAY_ENTRIES=2
```

## examples/shell_demo/sdkconfig.defaults
```kconfig
# Shell demo defaults
CONFIG_FREERTOS_HZ=1000
CONFIG_ESP_MAIN_TASK_STACK_SIZE=4096

# Enable shell
CONFIG_ZSHELL=y
CONFIG_ZSHELL_CMD_KERNEL=y
CONFIG_ZSHELL_CMD_LOG=y
CONFIG_ZSHELL_CMD_THREAD=y
CONFIG_ZSHELL_ECHO=y
CONFIG_ZSHELL_HISTORY=y
CONFIG_ZSHELL_VT100=y
CONFIG_ZSHELL_TAB_COMPLETION=y

# Enable zsys features for shell builtins
CONFIG_ZSYS_LOG_MODULE=y
CONFIG_ZSYS_RETRY=y

# SYS_INIT
CONFIG_ZKERNEL_SYS_INIT=y
```

## examples/uart_loopback/sdkconfig.defaults
```kconfig
CONFIG_FREERTOS_HZ=1000
CONFIG_ESP_MAIN_TASK_STACK_SIZE=8192

CONFIG_DEVICE_MODEL_GPIO=y
CONFIG_DEVICE_MODEL_UART=y
CONFIG_UART_INTERRUPT_DRIVEN=y
CONFIG_UART_ASYNC_API=y
CONFIG_UART_RS485=y

CONFIG_ZSYS_LOG_MODULE=y
```

## examples/uart_rs485_echo/sdkconfig.defaults
```kconfig
CONFIG_FREERTOS_HZ=1000
CONFIG_ESP_MAIN_TASK_STACK_SIZE=8192

CONFIG_DEVICE_MODEL_GPIO=y
CONFIG_DEVICE_MODEL_UART=y
CONFIG_UART_INTERRUPT_DRIVEN=y
CONFIG_UART_ASYNC_API=y
CONFIG_UART_RS485=y

CONFIG_ZSYS_LOG_MODULE=y

# zkernel k_sem reserves task-notification index 1
CONFIG_FREERTOS_TASK_NOTIFICATION_ARRAY_ENTRIES=2
```

## test/sdkconfig.defaults
```kconfig
# Boreas test defaults
CONFIG_FREERTOS_HZ=1000
CONFIG_ESP_MAIN_TASK_STACK_SIZE=8192

# Enable all Boreas features for testing
CONFIG_ZKERNEL_SYS_INIT=y
CONFIG_ZKERNEL_SYS_INIT_MAX_ENTRIES=32
CONFIG_ZKERNEL_MUTEX_DEBUG=y
CONFIG_ZKERNEL_MUTEX_HOLD_WARNING_MS=5000

CONFIG_ZSYS_LOG_MODULE=y
CONFIG_ZSYS_LOG_MAX_LEVEL=4
CONFIG_ZSYS_RETRY=y
CONFIG_K_TIMER_DISPATCH_ISR=y

# Shell (for unit testing parsing/history/completion)
CONFIG_ZSHELL=y
CONFIG_ZSHELL_CMD_KERNEL=n
CONFIG_ZSHELL_CMD_LOG=n
CONFIG_ZSHELL_CMD_THREAD=n
CONFIG_ZSHELL_CMD_DEVICE=n

# Unity test framework
CONFIG_UNITY_ENABLE_FLOAT=y

# zkernel k_sem reserves task-notification index 1
CONFIG_FREERTOS_TASK_NOTIFICATION_ARRAY_ENTRIES=2
```

## test/sdkconfig.defaults.qemu
```kconfig
# QEMU overrides: esp_timer ISR dispatch is not emulated.
CONFIG_K_TIMER_DISPATCH_ISR=n
```
