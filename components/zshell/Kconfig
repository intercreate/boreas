## components/zshell/Kconfig
```kconfig
menu "Boreas Shell (zshell)"

    config ZSHELL
        bool "Enable shell subsystem"
        default n
        help
            Enable the Zephyr-style interactive shell.

    config ZSHELL_CMD_BUFF_SIZE
        int "Command buffer size"
        default 128
        depends on ZSHELL

    config ZSHELL_PRINTF_BUFF_SIZE
        int "Printf buffer size"
        default 256
        depends on ZSHELL

    config ZSHELL_MAX_ROOT_CMDS
        int "Maximum number of root commands"
        default 32
        depends on ZSHELL

    config ZSHELL_MAX_ARGC
        int "Maximum number of command arguments"
        default 12
        depends on ZSHELL

    config ZSHELL_THREAD_STACK_SIZE
        int "Shell thread stack size (bytes)"
        default 4096
        depends on ZSHELL

    config ZSHELL_THREAD_PRIORITY
        int "Shell thread priority"
        default 5
        depends on ZSHELL

    config ZSHELL_PROMPT
        string "Default prompt string"
        default "boreas> "
        depends on ZSHELL

    config ZSHELL_PROMPT_CHANGE
        bool "Allow prompt change at runtime"
        default y
        depends on ZSHELL
        help
            Enable shell_prompt_change(). Adds a ZSHELL_PROMPT_BUFF_SIZE
            byte prompt buffer to each shell instance.
            Mirrors CONFIG_SHELL_PROMPT_CHANGE.

    config ZSHELL_PROMPT_BUFF_SIZE
        int "Prompt buffer size"
        range 2 40
        default 20
        depends on ZSHELL_PROMPT_CHANGE
        help
            Mirrors CONFIG_SHELL_PROMPT_BUFF_SIZE. Prompts of this length or
            longer (including NUL) are rejected with -EINVAL.

    config ZSHELL_START_OBSCURED
        bool "Display asterisk when echoing"
        default n
        depends on ZSHELL
        help
            Echo '*' instead of the typed character. Used for login prompts;
            toggle at runtime with shell_obscure_set().
            Mirrors CONFIG_SHELL_START_OBSCURED.

    config ZSHELL_CMD_ROOT
        string "Root command at init"
        default ""
        depends on ZSHELL
        help
            Restrict dispatch to this root command when the shell starts:
            typed input becomes its arguments and no other root command is
            reachable. Empty means the full command tree. Change at runtime
            with shell_set_root_cmd(). Mirrors CONFIG_SHELL_CMD_ROOT.

    config ZSHELL_HISTORY
        bool "Enable command history"
        default y
        depends on ZSHELL

    config ZSHELL_HISTORY_DEPTH
        int "Number of history entries"
        default 10
        depends on ZSHELL_HISTORY

    config ZSHELL_VT100
        bool "Enable VT100 escape sequence handling"
        default y
        depends on ZSHELL
        help
            Enable cursor movement, arrow keys, Home/End/Delete.

    config ZSHELL_TAB_COMPLETION
        bool "Enable tab completion"
        default y
        depends on ZSHELL

    config ZSHELL_ECHO
        bool "Enable character echo by default"
        default y
        depends on ZSHELL

    config ZSHELL_CMD_KERNEL
        bool "Enable built-in kernel commands (uptime, heap)"
        default y
        depends on ZSHELL

    config ZSHELL_CMD_LOG
        bool "Enable built-in log commands"
        default y
        depends on ZSHELL
        select ZSYS_LOG_MODULE

    config ZSHELL_CMD_THREAD
        bool "Enable built-in thread analyzer command"
        default y
        depends on ZSHELL
        select ZSYS_THREAD_ANALYZER

    config ZSHELL_CMD_DEVICE
        bool "Enable built-in device commands"
        default y
        depends on ZSHELL

endmenu
```

## components/zsys/Kconfig
```kconfig
menu "Boreas System Services (zsys)"

    config ZSYS_LOG_MODULE
        bool "Enable per-module runtime log level control"
        default y
        help
            Provides LOG_MODULE_REGISTER() macro for per-module log levels
            and a CLI-compatible API for runtime level changes.

    config ZSYS_LOG_MAX_MODULES
        int "Maximum number of log modules"
        default 32
        depends on ZSYS_LOG_MODULE
        help
            Maximum number of modules that can register via LOG_MODULE_REGISTER.

    config ZSYS_LOG_MAX_LEVEL
        int "Maximum compile-time log level (0=NONE, 1=ERR, 2=WRN, 3=INF, 4=DBG)"
        default 4
        depends on ZSYS_LOG_MODULE
        help
            Log calls above this level are compiled out entirely.
            0 = no logging, 1 = errors only, 2 = +warnings,
            3 = +info (default for most modules), 4 = +debug.

    config ZSYS_LOG_MSG_MAX_LEN
        int "Maximum formatted message length (bytes)"
        default 80
        depends on ZSYS_LOG_MODULE
        help
            Maximum length of the pre-formatted text field in each log message.
            Messages longer than this are truncated.

    config ZSYS_LOG_BACKEND_SHOW_COLOR
        bool "Colors in the backend"
        default y
        depends on ZSYS_LOG_MODULE
        help
            When enabled the backend prints errors in red and warnings in
            yellow, mirroring Zephyr's CONFIG_LOG_BACKEND_SHOW_COLOR. As
            upstream, the color spans the level indicator through the end
            of the message, and INF/DBG are uncolored unless the options
            below are set.

            Governs LOG_* (zsys) output only. ESP_LOG* traffic from
            ESP-IDF internals keeps ESP-IDF's own coloring, controlled by
            CONFIG_LOG_COLORS.

    config ZSYS_LOG_INFO_COLOR_GREEN
        bool "Use green color for info level logs"
        depends on ZSYS_LOG_BACKEND_SHOW_COLOR
        help
            Mirrors Zephyr's CONFIG_LOG_INFO_COLOR_GREEN. Off by default
            upstream; enable for ESP-IDF-style output, where INF is green.

    config ZSYS_LOG_DBG_COLOR_BLUE
        bool "Use blue color for debug level logs"
        depends on ZSYS_LOG_BACKEND_SHOW_COLOR
        help
            Mirrors Zephyr's CONFIG_LOG_DBG_COLOR_BLUE. Off by default.

    config ZSYS_LOG_MAX_BACKENDS
        int "Maximum number of log backends"
        default 4
        depends on ZSYS_LOG_MODULE
        help
            Maximum number of log backends that can be registered.

    config ZSYS_LOG_MODE_DEFERRED
        bool "Enable deferred (asynchronous) log output"
        default n
        depends on ZSYS_LOG_MODULE
        help
            When enabled, log messages are queued to a ring buffer and
            written by a dedicated output thread. ISR-safe, non-blocking.
            When disabled, log output is synchronous (immediate).

    config ZSYS_LOG_BUFFER_COUNT
        int "Number of log messages in deferred buffer"
        default 32
        depends on ZSYS_LOG_MODE_DEFERRED
        help
            Number of struct log_msg entries in the static ring buffer.
            Each entry is ~128 bytes. 32 entries = 4 KB.

    config ZSYS_LOG_THREAD_STACK_SIZE
        int "Log output thread stack size (bytes)"
        default 2048
        depends on ZSYS_LOG_MODE_DEFERRED

    config ZSYS_LOG_THREAD_PRIORITY
        int "Log output thread priority (FreeRTOS)"
        default 2
        depends on ZSYS_LOG_MODE_DEFERRED
        help
            Low priority so logging doesn't preempt application work.

    config ZSYS_THREAD_ANALYZER
        bool "Enable thread analyzer"
        default n
        select FREERTOS_USE_TRACE_FACILITY
        select FREERTOS_GENERATE_RUN_TIME_STATS
        help
            Runtime thread stack and CPU usage analysis.
            Provides zsys_thread_analyzer_print() for diagnostics.
            Automatically enables FreeRTOS trace facility and runtime stats.

    config ZSYS_WATCHDOG
        bool "Enable subsystem watchdog"
        default n
        help
            Per-subsystem watchdog with configurable timeouts.
            A supervisor task checks that all registered subsystems
            have fed their watchdog within the configured window.

    config ZSYS_WATCHDOG_MAX_ENTRIES
        int "Maximum watchdog entries"
        default 8
        depends on ZSYS_WATCHDOG

    config ZSYS_RETRY
        bool "Enable retry/backoff primitive"
        default y
        help
            Provides struct retry_ctx for consistent retry logic
            with fixed, exponential, or jitter backoff strategies.

endmenu
```
